## Documentation/devicetree/bindings/spi/spi_altera.txt
```
Altera SPI

Required properties:
- compatible : should be "ALTR,spi-1.0".

Optional property:
- bus-number : SPI bus number
```

## arch/nios2/Kconfig
```kconfig
config NIOS2
	def_bool y
	select HAVE_OPROFILE
	select USB_ARCH_HAS_HCD if USB_SUPPORT

config GENERIC_CSUM
	def_bool y

config GENERIC_FIND_NEXT_BIT
	def_bool y

config GENERIC_HWEIGHT
	def_bool y

config GENERIC_CALIBRATE_DELAY
	def_bool y

config GENERIC_TIME
	def_bool y

config GENERIC_HARDIRQS
	def_bool y

config GENERIC_HARDIRQS_NO__DO_IRQ
	def_bool y

config GENERIC_IRQ_PROBE
	def_bool y

config NO_IOPORT
	def_bool y

config ZONE_DMA
	def_bool y

config FPU
	def_bool n

config SWAP
	def_bool n

config RWSEM_GENERIC_SPINLOCK
	def_bool y

# FIXME: really !
config NOT_COHERENT_CACHE
	def_bool n

config TRACE_IRQFLAGS_SUPPORT
	def_bool n

config RAMKERNEL
	def_bool y

source "init/Kconfig"

source "kernel/Kconfig.preempt"

source "kernel/Kconfig.freezer"

source "arch/nios2/boards/Kconfig"

menu "Processor type and features"

config MMU
	bool "MMU support"
	default y
	help
	  This option enables support for the NiosII MMU. Only enable this
	  option if your design contains a NiosII/f core with MMU enabled.

menu "NiosII specific compiler options"

config NIOS2_HW_MUL_SUPPORT
	bool "Enable MUL instruction"
	default y
	help
	  Enables the -mhw-mul compiler flag.

config NIOS2_HW_MULX_SUPPORT
	bool "Enable MULX instruction"
	default n
	help
	  Enables the -mhw-mulx compiler flag.

config NIOS2_HW_DIV_SUPPORT
	bool "Enable DIV instruction"
	default n
	help
	  Enables the -mhw-div compiler flag.

endmenu

config OF
	bool "Devicetree support"
	def_bool n
	select DTC
	select OF_FLATTREE

config DTC
	bool
	depends on OF

config ALIGNMENT_TRAP
	bool "Catch alignment trap"
	default y
	help
	  NIOS II cpus cannot fetch/store data which is not bus aligned,
	  i.e., a 2 or 4 byte fetch must start at an address divisible by
	  2 or 4. Any non-aligned load/store instructions will be trapped and
	  emulated in software if you say Y here, which has a performance
	  impact.

source "mm/Kconfig"

menu "Exectuable file formats"

source "fs/Kconfig.binfmt"

endmenu

comment "Boot options"

config CMDLINE
	string "Default kernel command string"
	default ""
	help
	  On some platforms, there is currently no way for the boot loader to
	  pass arguments to the kernel. For these platforms, you can supply
	  some command-line options at build time by entering them here.  In
	  other cases you can specify kernel args so that you don't have
	  to set them up in board prom initialization routines.

config PASS_CMDLINE
	bool "Passed kernel command line from u-boot"
	default n
	help
	  Use bootargs env variable from u-boot for kernel command line.
	  will override "Default kernel command string".
          Say N if you are unsure.

config BOOT_LINK_OFFSET
	hex "Link address offset for booting"
	default "0x00500000"
	help
	  This option allows you to set the link address offset of the zImage.
	  This can be useful if you are on a board which has a small amount of
	  memory.

source "kernel/Kconfig.hz"

source "kernel/time/Kconfig"

comment "Platform driver options"

config AVALON_DMA
	bool "Support for DMA controller with Avalon interface"
	default y
	help
	  Support the Altera DMA controller with Avalon interface, so drivers
	  for DMA-able devices can use this interface.

source "arch/nios2/drivers/Kconfig"

endmenu

source "net/Kconfig"

source "drivers/Kconfig"

source "fs/Kconfig"

source "arch/nios2/Kconfig.debug"

source "security/Kconfig"

source "crypto/Kconfig"

source "lib/Kconfig"
```

## arch/nios2/Kconfig.debug
```kconfig
menu "Kernel hacking"

config TRACE_IRQFLAGS_SUPPORT
	def_bool y

source "lib/Kconfig.debug"

config EARLY_PRINTK
	bool "Activate early kernel debugging"
	default y
	help
	  Enable early printk on console

config DEBUG_STACK_USAGE
	bool "Enable stack utilization instrumentation"
	depends on DEBUG_KERNEL
	help
	  Enables the display of the minimum amount of free stack which each
	  task has ever had available in the sysrq-T and sysrq-P debug output.

	  This option will slow down process creation somewhat.

endmenu
```

## arch/nios2/boards/3c120/Kconfig
```kconfig
if 3C120

choice
	prompt "FPGA configuration"

config NIOS2_DEFAULT_MMU
	bool "MMU_DEFAULT"
	help
	  The default mmu config for the v17 release

config NIOS2_MAXIMUM_MMU
	bool "MAXIMUM_MMU"
	help
	  The maximum mmu config for the v17 release

endchoice

endif
```

## arch/nios2/boards/Kconfig
```kconfig
menu "NiosII board configuration"

choice
	prompt "board configuration"

config 3C120
	bool "3C120 dev board"
	help
	  The Altera 3C120 dev board support.

config NEEK
	bool "Nios Embedded Evaluation Kit"
	help
	  The Altera Nios Embedded Evaluation Kit support.

config NIOS2_GENERIC_DTS
	bool "Generic devicetree based NiosII system"
	select OF
	help
	  Select this to have a flexible system with only the bare essentials
	  compiled into the kernel and the rest all supplied by a device-tree.
	  You can select a default dts file or suply your own.

endchoice

source "arch/nios2/boards/3c120/Kconfig"
source "arch/nios2/boards/neek/Kconfig"
source "arch/nios2/boards/generic-dts/Kconfig"

endmenu
```

## arch/nios2/boards/generic-dts/Kconfig
```kconfig
if NIOS2_GENERIC_DTS

config NIOS2_DTB_AT_PHYS_ADDR
	bool "DTB at physical address"
	depends on NIOS2_GENERIC_DTS
	default n
	help
	  When enabled you can select a physical address to load the dtb from.
	  Normally this address is passed by a bootloader such as u-boot but
	  using this you can use a devicetree without a bootloader.
	  This way you can store a devicetree in NOR flash or an onchip rom.
	  Please not that this addres is used directly so you have to manually
	  do address translation if it's connected to a bridge. Also take into
	  account that when using an MMU you'd have to ad 0xC0000000 to your 
	  address

config NIOS2_DTB_PHYS_ADDR
	hex "DTB Address"
	depends on NIOS2_DTB_AT_PHYS_ADDR
	default "0xC0000000"
	help
	  Physical address of a dtb blob.

endif
```

## arch/nios2/boards/neek/Kconfig
```kconfig
if NEEK

choice
	prompt "FPGA configuration"

config NIOS2_CUSTOM_FPGA
	bool "CUSTOM_FPGA"
	help
	  Adapt the kernel to custom FPGA configuration. You will
	  need to generate a header file for your desgin using the
	  "sopc-create-header-files" scripts provided by Altera.
	  The file "include/asm-nios2/custom_fpga.h" will be used.

config NIOS2_NEEK_OCM
	bool "neek_ocm_spi_mmu"
	help
	  The neek_ocm_spi_mmu example design. You may find this
	  design from http://nioswiki.com/Linux.

endchoice

endif
```

## arch/nios2/drivers/Kconfig
```kconfig
# Platfrom drivers configuration

menu "Additional NiosII Device Drivers"

source "arch/nios2/drivers/pci/Kconfig"

config ALTERA_REMOTE_UPDATE
	bool "Remote update support"
	depends on NIOS2
	default N
	help
	  This driver provides support for automatic reconfiguration of a
	  CycloneIII FPGA (Possibly others too).

choice ALTERA_REMOTE_UPDATE_FLASH_WIDTH
	prompt "FPGA configuration flash data width"
	depends on ALTERA_REMOTE_UPDATE
	default ALTERA_REMOTE_UPDATE_FLASH_WIDTH_16
	help
	  The ALTREMOTE_UPDATE megafunction requires that you only provide it
	  the 22 highest-order bits of a 24-bit address offset.

	  This options controls the value by which the address offset of the
	  FPGA configuration image is shifted depending on the data width of
	  the flash where your image is stored.

	  EPCS flash data witdh is usually 8 bit
	  CFI flash data width is usually 16 bit

config ALTERA_REMOTE_UPDATE_FLASH_WIDTH_8
	bool "8 bits (shift address by 2)"
config ALTERA_REMOTE_UPDATE_FLASH_WIDTH_16
	bool "16 bits (shift address by 3)"
endchoice

config PIO_DEVICES
	tristate "Enable NiosII PIO driver"
	default n
	help

config PIO_LED
	bool "Enable NiosII PIO LED driver"
	depends on PIO_DEVICES
	default n
	help
	  Enable the example PIO LED driver (which just displays a timer value
	  on the 8 LEDs)

config GENERIC_GPIO
	bool
	depends on NIOS2_GPIO || ALTERA_PIO_GPIO

config NIOS2_GPIO
	bool "GPIO driver"
	default n
	select GENERIC_GPIO
	help
	  The custom gpio core, openip/gpio, uses fewer LEs and runs faster
	  than the Altera PIO. The spinlock is no longer needed.

config ALTERA_PIO_GPIO
	bool "Altera PIO to GPIO driver"
	default n
	select GENERIC_GPIO
	help
	  This driver provides GPIO support for Altera PIO. Each PIO port is
	  expanded to 32 gpio pins. And multiple PIO ports can be accessed by
	  the array. Interrupt is not supported.

endmenu
```

## arch/nios2/platform/Kconfig.platform
```kconfig
menu "Platform options"

comment "Memory settings"

config MEM_BASE
	hex "Memory base address"
	default "0x00000000"
	help
	  This is the physical address of the memory that the kernel will run
	  from. This address is used to link the kernel and setup initial memory
	  management. You should take the raw memory address without any MMU
	  or cache bits set.
	  Please not that this address is used directly so you have to manually
	  do address translation if it's connected to a bridge.

comment "Device tree"

config NIOS2_DTB_AT_PHYS_ADDR
	bool "DTB at physical address"
	default n
	help
	  When enabled you can select a physical address to load the dtb from.
	  Normally this address is passed by a bootloader such as u-boot but
	  using this you can use a devicetree without a bootloader.
	  This way you can store a devicetree in NOR flash or an onchip rom.
	  Please not that this addres is used directly so you have to manually
	  do address translation if it's connected to a bridge. Also take into
	  account that when using an MMU you'd have to ad 0xC0000000 to your
	  address

config NIOS2_DTB_PHYS_ADDR
	hex "DTB Address"
	depends on NIOS2_DTB_AT_PHYS_ADDR
	default "0xC0000000"
	help
	  Physical address of a dtb blob.

config DTB_SOURCE_BOOL
	bool "Compile and link device tree into kernel image"
	default n
	help
	  This allows you to specify a dts (device tree source) file
	  which will be compiled and linked into the kernel image.

config DTB_SOURCE
	string "Device tree source file"
	depends on DTB_SOURCE_BOOL
	default ""
	help
	  Absolute path to the device tree source (dts) file describing your
	  system.

comment "Nios II instructions"

config NIOS2_HW_MUL_SUPPORT
	int "Enable MUL instruction (0=none, 1=MUL)"
	default 0
	help
	  Set to 1 if you configured the NiosII to include the MUL instruction.
	  This will enable the -mhw-mul compiler flag.

config NIOS2_HW_MULX_SUPPORT
	int "Enable MULX instruction (0=none, 1=MULX)"
	default 0
	help
	  Set to 1 if you configured the NiosII to include the MULX instruction.
	  Enables the -mhw-mulx compiler flag.

config NIOS2_HW_DIV_SUPPORT
	int "Enable DIV instruction (0=none, 1=DIV)"
	default 0
	help
	  Set to 1 if you configured the NiosII to include the DIV instruction.
	  Enables the -mhw-div compiler flag.

config NIOS2_FPU_SUPPORT
	bool "Custom floating point instr support"
	default n
	help
	  Enables the -mcustom-fpu-cfg=60-1 compiler flag.

comment "Cache settings"

config CUSTOM_CACHE_SETTINGS
	bool "Custom cache settings"
	help
	  This option allows you to tweak the cache settings used during early
	  boot (where the information from device tree is not yet available).
	  There should be no reason to change these values. Linux will work
	  perfectly fine, even if the Nios II is configured with smaller caches.

	  Say N here unless you know what you are doing.

config NIOS2_DCACHE_SIZE
	hex "D-Cache size" if CUSTOM_CACHE_SETTINGS
	default "0x10000"
	help
	  Maximum possible data cache size.

config NIOS2_DCACHE_LINE_SIZE
	hex "D-Cache line size" if CUSTOM_CACHE_SETTINGS
	default "0x4"
	help
	  Minimum possible data cache line size.

config NIOS2_ICACHE_SIZE
	hex "I-Cache size" if CUSTOM_CACHE_SETTINGS
	default "0x10000"
	help
	  Maximum possible instruction cache size.

config NIOS2_ICACHE_LINE_SIZE
	hex "I-Cache line size" if CUSTOM_CACHE_SETTINGS
	default "0x20"
	help
	  Maximum possible instruction cache line size.

config NIOS2_ICACHE_LINE_SHIFT
	hex "I-Cache line shift" if CUSTOM_CACHE_SETTINGS
	default "0x5"
	help
	  log2 of the instruction cache line size. This must match
	  CONFIG_NIOS2_ICACHE_LINE_SIZE.

endmenu
```

## arch/nios2/platform/generic/Kconfig
```kconfig
comment "Device tree"

config NIOS2_DTB_AT_PHYS_ADDR
	bool "DTB at physical address"
	default n
	help
	  When enabled you can select a physical address to load the dtb from.
	  Normally this address is passed by a bootloader such as u-boot but
	  using this you can use a devicetree without a bootloader.
	  This way you can store a devicetree in NOR flash or an onchip rom.
	  Please not that this addres is used directly so you have to manually
	  do address translation if it's connected to a bridge. Also take into
	  account that when using an MMU you'd have to ad 0xC0000000 to your
	  address

config NIOS2_DTB_PHYS_ADDR
	hex "DTB Address"
	depends on NIOS2_DTB_AT_PHYS_ADDR
	default "0xC0000000"
	help
	  Physical address of a dtb blob.

config DTB_SOURCE_BOOL
	bool "Compile and link device tree into kernel image"
	default n
	help
	  This allows you to specify a dts (device tree source) file
	  which will be compiled and linked into the kernel image.

config DTB_SOURCE
	string "Device tree source file"
	depends on DTB_SOURCE_BOOL
	default ""
	help
	  Absolute path to the device tree source (dts) file describing your
	  system.

comment "Nios II instructions"

config NIOS2_HW_MUL_SUPPORT
	int "Enable MUL instruction (0=none, 1=MUL)"
	default 0
	help
	  Set to 1 if you configured the NiosII to include the MUL instruction.
	  This will enable the -mhw-mul compiler flag.

config NIOS2_HW_MULX_SUPPORT
	int "Enable MULX instruction (0=none, 1=MULX)"
	default 0
	help
	  Set to 1 if you configured the NiosII to include the MULX instruction.
	  Enables the -mhw-mulx compiler flag.

config NIOS2_HW_DIV_SUPPORT
	int "Enable DIV instruction (0=none, 1=DIV)"
	default 0
	help
	  Set to 1 if you configured the NiosII to include the DIV instruction.
	  Enables the -mhw-div compiler flag.

config NIOS2_FPU_SUPPORT
	bool "Custom floating point instr support"
	default n
	help
	  Enables the -mcustom-fpu-cfg=60-1 compiler flag.
```
